## conf/layer.conf
```bitbake
# We have a conf and classes directory, add to BBPATH
BBPATH := "${BBPATH}:${LAYERDIR}"

# We have a packages directory, add to BBFILES
BBFILES += "${LAYERDIR}/recipes-*/*/*.bb \
            ${LAYERDIR}/recipes-*/*/*.bbappend"

BBFILE_COLLECTIONS += "meta-crashhandler"
BBFILE_PATTERN_meta-crashhandler = "^${LAYERDIR}/"
BBFILE_PRIORITY_meta-crashhandler = "6"

LAYERVERSION_meta-crashhandler = "1"
```
